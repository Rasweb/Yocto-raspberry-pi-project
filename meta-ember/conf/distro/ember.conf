## meta-ember/conf/distro/ember.conf
```bitbake
# Internal distro identifier
DISTRO = "ember"

# Human-readable display name
DISTRO_NAME = "Ember"

# Distro version string
DISTRO_VERSION = "1.0.0"

# Required for USB to TTL connection
ENABLE_UART = "1"
SERIAL_CONSOLES = "115200;ttyAMA0"

# Provides support for creating packages that use the Debian(.deb) file format
PACKAGE_CLASSES = "package_deb"

# Distro features
DISTRO_FEATURES:append = " systemd usrmerge"

# Init system
INIT_MANAGER = "systemd"

# Additional image features
EXTRA_IMAGE_FEATURES:append = " allow-root-login empty-root-password"

LICENSE_FLAGS_ACCEPTED:append = "synaptics-killswitch"
```

## sources/meta-ember/conf/layer.conf
```bitbake
# We have a conf and classes directory, add to BBPATH
BBPATH .= ":${LAYERDIR}"

# We have recipes-* directories, add to BBFILES
BBFILES += "${LAYERDIR}/recipes-*/*/*.bb \
            ${LAYERDIR}/recipes-*/*/*.bbappend"

BBFILE_COLLECTIONS += "meta-ember"
BBFILE_PATTERN_meta-ember = "^${LAYERDIR}/"
BBFILE_PRIORITY_meta-ember = "6"

LAYERDEPENDS_meta-ember = "core"
LAYERSERIES_COMPAT_meta-ember = "wrynose"
```
